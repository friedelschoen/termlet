## lib/Kconfig
```kconfig
# Copyright (c) 2021 Legrand North America, LLC.
# SPDX-License-Identifier: Apache-2.0

menu "Custom libraries"

rsource "fonts/Kconfig"
rsource "libtsm/Kconfig"
rsource "wcwidth/Kconfig"
rsource "keymap/Kconfig"
rsource "libutf8/Kconfig"
rsource "window/Kconfig"
rsource "lua/Kconfig"
rsource "fs/Kconfig"

endmenu
```

## lib/fs/devfs/Kconfig
```kconfig
menuconfig DEVFS
	bool "devices tree"
	default y

    depends on FILE_SYSTEM

if DEVFS

config DEVFS_MAX_FDS
	int "Maximum number of open descriptors"
	default 8
	range 1 64

config DEVFS_INIT_PRIORITY
	int "Initialization priority"
	default 90

endif
```

## lib/fs/sysfs/Kconfig
```kconfig
menuconfig SYSFS
	bool "Embedded read-only sysfs"
	default y

    depends on FILE_SYSTEM

if SYSFS

config SYSFS_MAX_FDS
	int "Maximum number of open descriptors"
	default 8
	range 1 64

config SYSFS_INIT_PRIORITY
	int "Initialization priority"
	default 90

endif
```

## lib/keymap/Kconfig
```kconfig
config KEYMAP
    bool "keymap library"

if KEYMAP
config KEYMAP_KEYBOARD_LOCALE
    string "keymap locale"
    default "en_US.UTF-8"

config KEYMAP_KEYBOARD_LAYOUT
    string "keymap layout"
    default "us"

config KEYMAP_KEYBOARD_VARIANT
    string "keymap variant"
    default "intl"

endif
```

## lib/libtsm/Kconfig
```kconfig
config LIBTSM
    bool "Enable libtsm"
    depends on WCWIDTH

if LIBTSM

config LIBTSM_MAX_HEIGHT
    int "maximum of terminal height"
    default 40

config LIBTSM_MAX_WIDTH
    int "maximum of terminal width"
    default 140

module = LIBTSM
module-str = Terminal-emulator State Machine
source "subsys/logging/Kconfig.template.log_config"

endif
```

## lib/lua/Kconfig
```kconfig
config LUA
    bool "use lua-library"

#    depends on POSIX_FILE_SYSTEM
#    depends on POSIX_DEVICE_IO
#    depends on POSIX_FD_MGMT
#    depends on POSIX_MULTI_PROCESS
```

## lib/window/Kconfig
```kconfig
config WINDOW
  bool "enable windowing lib"

if WINDOW

config WINDOW_LAYOUT_MAX_WINDOWS
  int "maximal allocatable windows"
  default 16

endif
```

## west.yml
```yaml
# Copyright (c) 2021 Nordic Semiconductor ASA
# SPDX-License-Identifier: Apache-2.0

manifest:
  self:
    west-commands: scripts/west-commands.yml

  remotes:
    - name: zephyrproject-rtos
      url-base: https://github.com/zephyrproject-rtos

    - name: golang
      url-base: https://github.com/golang
    
    - name: friedelschoen
      url-base: https://github.com/friedelschoen

  projects:
    - name: zephyr
      remote: zephyrproject-rtos
      revision: v4.5.0-rc1
      import:
        name-allowlist:
          - net-tools
          - picolibc
          - hal_espressif

    - name: go-fonts
      url: https://github.com/golang/image
      revision: v0.45.0
      path: modules/fonts/go

    - name: minitelnet
      remote: friedelschoen
      revision: main
      path: modules/lib/minitelnet
```
